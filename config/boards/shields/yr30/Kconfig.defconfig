## config/boards/shields/yr30/Kconfig.defconfig
```kconfig
# Copyright (c) 2021 The ZMK Contributors
# SPDX-License-Identifier: MIT


if SHIELD_YR30_LEFT
# 右親機にしたければ "if SHIELD_YR30_RIGHT" にする

config ZMK_KEYBOARD_NAME
    default "yr30 Keyboard"

config ZMK_SPLIT_ROLE_CENTRAL
    default y

endif


if SHIELD_YR30_LEFT || SHIELD_YR30_RIGHT

config ZMK_SPLIT
    default y

endif
```

## config/boards/shields/yr30/Kconfig.shield
```kconfig
config SHIELD_YR30_LEFT
    def_bool $(shields_list_contains,yr30_left)

config SHIELD_YR30_RIGHT
    def_bool $(shields_list_contains,yr30_right)
```
